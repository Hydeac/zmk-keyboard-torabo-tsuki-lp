#include "torabo_tsuki_lp.dtsi"
#include <input/processors.dtsi>
#include <dt-bindings/zmk/input_transform.h>

#define VIEW_LAYER 7  // keymapの視点操作レイヤー番号に合わせる

&pointing_listener {
    // 通常時: スクロール（右のscrollerと同じ構成）
    input-processors = <&zip_xy_to_scroll_mapper>,
                       <&zip_scroll_transform (INPUT_TRANSFORM_X_INVERT)>,
                       <&zip_scroll_scaler 1 128>;

    // 視点操作キー押下中: XYをそのまま通す
    view {
        layers = <VIEW_LAYER>;
        input-processors = <&zip_xy_transform (INPUT_TRANSFORM_X_INVERT | INPUT_TRANSFORM_Y_INVERT)>,
                           <&zip_xy_scaler 1 4>;  // 感度は好みで
    };
};